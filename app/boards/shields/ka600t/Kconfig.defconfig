## app/boards/shields/ka600t/Kconfig.defconfig
```kconfig
# Copyright (c) 2020 The ZMK Contributors
# SPDX-License-Identifier: MIT

if SHIELD_KA600

config ZMK_KEYBOARD_NAME
    default "KA600"

config ZMK_BLE
	default y

config ZMK_USB
	default y

config USB_DEVICE_MANUFACTURER
	default "ZMK Project"

endif
```

## config/app/boards/shields/ka600/Kconfig.shield
```kconfig
# Copyright (c) 2021 The ZMK Contributors
# SPDX-License-Identifier: MIT

config SHIELD_KA600
    def_bool $(shields_list_contains,ka600)
```

## config/west.yml
```yaml
manifest:
  remotes:
    - name: zmkfirmware
      url-base: https://github.com/zmkfirmware
    - name: tri-state
      url-base: https://github.com/caksoylar
  projects:
    - name: zmk
      remote: tri-state
      revision: caksoylar/experimental
      import: app/west.yml
  self:
    path: config
```
